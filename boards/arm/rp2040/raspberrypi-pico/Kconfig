## boards/arm/rp2040/raspberrypi-pico/Kconfig
```kconfig
#
# For a description of the syntax of this configuration file,
# see the file kconfig-language.txt in the NuttX tools repository.
#

if ARCH_BOARD_RASPBERRYPI_PICO

config RP2040_AP_IMAGE
	bool "Build as AP image (SRAM-only, for bootloader loading)"
	default n
	---help---
		Build the image as an AP (Application Processor) image that
		will be loaded by the bootloader.  Uses the SRAM AP linker
		script with ORIGIN at CONFIG_BOOT_RP2040BOOT_AP_BASE.

config RP2040_AP_PIE
	bool "Build AP image as position-independent executable (PIE)"
	depends on RP2040_AP_IMAGE
	default n
	---help---
		Link the AP image as an ET_DYN position-independent executable
		using -fpie -pie --no-dynamic-linker, instead of a fixed-address
		ET_EXEC image.  Requires CONFIG_LIBC_ELF_LOADTO_LMA on the
		bootloader side to relocate the PIE image to its runtime SRAM
		address via libelf_bind().  The AP image must NOT be stripped
		(--strip-all) because libelf_bind() depends on .symtab.

endif
```

## boards/arm/rp2040/waveshare-rp2040-lcd-1.28/Kconfig
```kconfig
#
# For a description of the syntax of this configuration file,
# see the file kconfig-language.txt in the NuttX tools repository.
#

if ARCH_BOARD_WAVESHARE_RP2040_LCD_1_28

config RP2040_AP_IMAGE
	bool "Build as AP image (SRAM-only, for bootloader loading)"
	default n
	---help---
		Build the image as an AP (Application Processor) image that
		will be loaded by the bootloader.  Uses the SRAM AP linker
		script with ORIGIN at CONFIG_RP2040_AP_BASE.

config RP2040_BOOTLOADER_DEBUG_NODES
	bool "Expose first-stage bootloader debug/scaffolding device nodes"
	default n
	depends on RP2040_BOOT_ELF
	---help---
		Register the bring-up scaffolding character/MTD nodes used while
		developing the first-stage bootloader: the whole-chip flash node
		/dev/rpflashall, the txtable helpers /dev/txtable_mk and
		/dev/txtable_erase, and the MTD-path probe /dev/flash_probe.

		These nodes expose write access to the entire flash (including the
		bootloader partition itself).  Filesystem permission bits are not
		enforced in this configuration (CONFIG_FS_PERMISSION=n), so a node
		that is readable is also writable.  Leave this off in a production
		bootloader: its flash is updated only through the ROM BOOTSEL path
		with a host tool (picotool), so there is no legitimate run-time
		writer for the bootloader region, and a stray "fastboot flash
		rpflashall" would erase the running image.

		Enable it only for local bring-up when the extra observability or
		manual triggers are needed.

endif
```

## boards/arm/rp2040/waveshare-rp2040-lcd-1.28/configs/ap_usbnsh_elf/defconfig
```kconfig
#include "../usbnsh/defconfig"
# CONFIG_RP2040_FLASH_BOOT is not set
# CONFIG_RP2040_UF2_BINARY is not set
CONFIG_RP2040_IMAGE_AP_ELF=y
```

## boards/arm/rp2040/waveshare-rp2040-lcd-1.28/configs/bootloader/defconfig
```kconfig
#include "../fastboot_usb/defconfig"
CONFIG_BCH=y
CONFIG_BOARDCTL_BOOT_IMAGE=y
CONFIG_BOARDCTL_RESET_CAUSE=y
CONFIG_DRVR_MKRD=y
CONFIG_ETC_ROMFS=y
CONFIG_FS_ROMFS=y
CONFIG_LIBC_ELF=y
CONFIG_LIBC_ELF_LOADTO_LMA=y
CONFIG_LIBC_EXECFUNCS=y
CONFIG_MTD=y
CONFIG_MTD_PARTITION=y
CONFIG_PIPES=y
CONFIG_RAM_SIZE=32768
CONFIG_RP2040_IMAGE_BOOTLOADER=y
CONFIG_SYSTEM_FASTBOOTD_SHELL=y
CONFIG_SYSTEM_NSH=y
CONFIG_SYSTEM_POPEN=y
CONFIG_TXTABLE_DEFAULT_PARTITION=1
CONFIG_TXTABLE_DEFAULT_PARTITION_PATH="/etc/txtable.txt"
CONFIG_TXTABLE_PARTITION=y
CONFIG_TXTABLE_PARTITION_MAX_NUM=16
```
